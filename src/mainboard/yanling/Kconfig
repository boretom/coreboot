## src/mainboard/yanling/Kconfig
```kconfig
if VENDOR_YANLING

choice
	prompt "Mainboard model"

source "src/mainboard/yanling/*/Kconfig.name"

endchoice

source "src/mainboard/yanling/*/Kconfig"

config MAINBOARD_VENDOR
	default "Yanling"

endif # VENDOR_YANLING
```

## src/mainboard/yanling/yl_kbr6l/Kconfig
```kconfig
if BOARD_YANLING_YLKBR6L

config BOARD_SPECIFIC_OPTIONS
	def_bool y
	select BOARD_ROMSIZE_KB_8192
	select HAVE_ACPI_RESUME
	select HAVE_ACPI_TABLES
	select INTEL_GMA_HAVE_VBT
	select MAINBOARD_HAS_LIBGFXINIT
	select SEABIOS_ADD_SERCON_PORT_FILE if PAYLOAD_SEABIOS
	select SOC_INTEL_KABYLAKE
	select SPI_FLASH_MACRONIX
	select SUPERIO_ITE_IT8613E
	select MAINBOARD_HAS_CRB_TPM
	select HAVE_INTEL_PTT
	select TPM2

config IRQ_SLOT_COUNT
	int
	default 18

config MAINBOARD_DIR
	string
	default "yanling/yl_kbr6l"

config MAINBOARD_PART_NUMBER
	string
	default "YLKBR6L"

config DIMM_MAX
	int
	default 2

config DIMM_SPD_SIZE
	int
	default 512

config MAX_CPUS
	int
	default 8

config VGA_BIOS_ID
	string
	default "8086,5917"

config PXE_ROM_ID
	string
	default "8086,1539"

config CBFS_SIZE
	hex
	default 0x600000

config USE_PM_ACPI_TIMER
	default n

endif
```
